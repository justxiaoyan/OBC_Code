## 2-obc-sdk/obc-1.0.0/Kconfig
```kconfig
#
# OBC SDK Configuration
#

mainmenu "OBC SDK Configuration"

config OBC_SDK_VERSION
	string
	default "1.0.0"

menu "Platform Configuration"

choice
	prompt "Platform Selection"
	default PLATFORM_IMX6ULL

config PLATFORM_IMX6ULL
	bool "iMX6ULL Platform"
	help
	  Enable support for NXP i.MX6ULL platform.

config PLATFORM_RV1106
	bool "RV1106 Platform"
	help
	  Enable support for Rockchip RV1106 platform.

config PLATFORM_PLATDEMO
	bool "Platform Demo"
	help
	  Enable support for platform demo.

endchoice

config PLATFORM_CONFIG
	string
	default "imx6ull" if PLATFORM_IMX6ULL
	default "rv1106" if PLATFORM_RV1106
	default "platdemo" if PLATFORM_PLATDEMO

config UBOOT_BIN_NAME
	string "U-Boot Binary Name"
	default "u-boot-dtb.imx" if PLATFORM_IMX6ULL
	default "u-boot.bin" if PLATFORM_RV1106
	help
	  U-Boot binary file name.

config FDT_BIN_NAME
	string "Device Tree Binary Name"
	default "imx6ull-14x14-evk.dtb" if PLATFORM_IMX6ULL
	default "rv1106.dtb" if PLATFORM_RV1106
	help
	  Device tree binary file name.

config KERNEL_BIN_NAME
	string "Kernel Binary Name"
	default "zImage"
	help
	  Kernel binary file name.

config ROOTFS_BIN_NAME
	string "Rootfs Binary Name"
	default "rootfs.ext2"
	help
	  Root filesystem binary file name.

config UBOOT_VERSION
	string "U-Boot Version"
	default "nxp-2024.04" if PLATFORM_IMX6ULL
	default "rockchip-2024.04" if PLATFORM_RV1106
	help
	  U-Boot version string.

config KERNEL_VERSION
	string "Kernel Version"
	default "nxp-6.12" if PLATFORM_IMX6ULL
	default "rockchip-6.1" if PLATFORM_RV1106
	help
	  Kernel version string.

endmenu

menu "Build Configuration"

config OBC_SDK_ARCH
	string "Target Architecture"
	default "arm"
	help
	  Target architecture for cross-compilation.

config OBC_SDK_COMP
	string "Cross Compiler Prefix"
	default "arm-buildroot-linux-gnueabihf-" if PLATFORM_IMX6ULL
	default "arm-none-linux-gnueabihf-" if PLATFORM_RV1106
	help
	  Cross compiler toolchain prefix.

endmenu

menu "Bootloader Configuration"

source "bootloader/obcbase/Kconfig"

endmenu

menu "Tools Configuration"

source "tools/pack_tools/Kconfig"

endmenu

menu "Application File System (appfs)"

source "appfs/Kconfig"

endmenu
```

## bootloader/obcbase/Kconfig
```kconfig
#
# obc base config
#


config OBC_BASE
	bool
	default y
	help
	  uboot support obc base config

config BOARD_CONFIG_AM62X
	bool
	depends on PLATFORM_AM62X || SOC_K3_AM625
	default y

config BOARD_CONFIG_IMX6ULL
	bool
	depends on PLATFORM_IMX6ULL || TARGET_MX6ULL_14X14_EVK
	default y

config BOARD_CONFIG_RV1106
	bool
	default y if PLATFORM_RV1106

config BOARD_CONFIG_RK3562
	bool
	default y if PLATFORM_RK3562

config OBC_BASE_TIBOOT
	bool  "Emable obc boot ti boot config"
    depends on OBC_BASE
	help
	  uboot support obc base ti boot config

config OBC_BASE_TIUBOOT
	bool "Emable obc boot ti uboot config"
    depends on OBC_BASE
	select IMAGE_SPARSE
	help
	  uboot support obc base ti uboot config
```

## module/Kconfig
```kconfig
menu "Kernel Modules"

config MODULE_SHARED_MEMORY
	bool "Enable shared_memory driver (/dev/shared_memory)"
	default n
	help
	  Build the shared memory driver for inter-process communication.
	  This driver provides a character device interface for shared memory operations.

config OBC_BASE
	bool "Enable AM62x OBC base driver"
	depends on PLATFORM_AM62X
	default y if PLATFORM_AM62X
	help
	  Build the external obcbase.ko module used to expose the OBC boot
	  medium, active slot and partition layout through /proc/obcbase.

endmenu
```

## module/shared_memory/Config.in
```kconfig
#
#	create by liuzhengwu 20230206
# 	HAT-BSP drivers Kconfig
#

menuconfig HAT_SHARED_MEMORY
	bool "shared memory driver(/dev/shared_memory) modules"
	depends on BASEAL_BASE
	help
	  a basic configuration for the platform resource.
```

## obc-1.0.0/Kconfig
```kconfig
#
# OBC SDK Configuration
#

mainmenu "OBC SDK Configuration"

config OBC_SDK_VERSION
	string
	default "1.0.0"

menu "Platform Configuration"

choice
	prompt "Platform Selection"
	default PLATFORM_IMX6ULL

config PLATFORM_IMX6ULL
	bool "iMX6ULL Platform"
	help
	  Enable support for NXP i.MX6ULL platform.

config PLATFORM_RV1106
	bool "RV1106 Platform"
	help
	  Enable support for Rockchip RV1106 platform.

config PLATFORM_RK3562
	bool "RK3562 Platform"
	help
	  Enable support for Rockchip RK3562 platform.

config PLATFORM_PLATDEMO
	bool "Platform Demo"
	help
	  Enable support for platform demo.

endchoice

config PLATFORM_CONFIG
	string
	default "imx6ull" if PLATFORM_IMX6ULL
	default "rv1106" if PLATFORM_RV1106
	default "rk3562" if PLATFORM_RK3562
	default "platdemo" if PLATFORM_PLATDEMO

config GIT_SOURCE
	string
	default "git@github.com:justxiaoyan/imx6ull_sdk_source.git" if PLATFORM_IMX6ULL
	default "git@github.com:justxiaoyan/rv1106_sdk_source.git" if PLATFORM_RV1106
	default "git@github.com:justxiaoyan/rk3562_sdk_source.git" if PLATFORM_RK3562

config SDK_NAME
	string
	default "imx6ull_sdk_source" if PLATFORM_IMX6ULL
	default "rv1106_sdk_source" if PLATFORM_RV1106
	default "rk3562_sdk_source" if PLATFORM_RK3562

config UBOOT_BIN_NAME
	string "U-Boot Binary Name"
	default "u-boot-dtb.imx" if PLATFORM_IMX6ULL
	default "u-boot.bin" if PLATFORM_RV1106
	default "u-boot.bin" if PLATFORM_RK3562
	help
	  U-Boot binary file name.

config UBOOT_DEFCONFIG
	string "U-Boot Defconfig"
	default "rk3562_defconfig" if PLATFORM_RK3562
	help
	  Defconfig used to configure U-Boot before building.

config UBOOT_BUILD_TARGET
	string "U-Boot Build Target"
	default "all" if PLATFORM_RK3562
	help
	  Make target used to build U-Boot.

config UBOOT_BUILD_SPL
	bool "Build U-Boot SPL"
	default y if PLATFORM_RK3562
	help
	  Build and install the SPL image required by the platform.

config SPL_BIN_NAME
	string "SPL Binary Name"
	default "spl/u-boot-spl.bin" if PLATFORM_RK3562
	depends on UBOOT_BUILD_SPL
	help
	  Path to the SPL binary relative to the U-Boot source directory.

config RKBIN_PATH
	string "Rockchip Binary Tools Path"
	default "rkbin" if PLATFORM_RK3562
	depends on UBOOT_BUILD_SPL
	help
	  Path to Rockchip binary tools relative to the U-Boot source directory.

config FDT_BIN_NAME
	string "Device Tree Binary Name"
	default "imx6ull-14x14-evk.dtb" if PLATFORM_IMX6ULL
	default "rv1106.dtb" if PLATFORM_RV1106
	default "u-boot.dtb" if PLATFORM_RK3562
	help
	  Device tree binary file name.

config KERNEL_BIN_NAME
	string "Kernel Binary Name"
	default "boot.img" if PLATFORM_RK3562
	default "zImage"
	help
	  Kernel binary file name.

config ROOTFS_BIN_NAME
	string "Rootfs Binary Name"
	default "rootfs.ext2"
	help
	  Root filesystem binary file name.

config UBOOT_VERSION
	string "U-Boot Version"
	default "nxp-2024.04" if PLATFORM_IMX6ULL
	default "rockchip-2024.04" if PLATFORM_RV1106
	help
	  U-Boot version string.

config KERNEL_VERSION
	string "Kernel Version"
	default "nxp-6.12" if PLATFORM_IMX6ULL
	default "rockchip-6.1" if PLATFORM_RV1106
	help
	  Kernel version string.

config KERNEL_DEFCONFIG
	string "Kernel Defconfig"
	default "rockchip_linux_defconfig" if PLATFORM_RK3562
	help
	  Defconfig used to configure the kernel before building.

config KERNEL_BUILD_TARGET
	string "Kernel Build Target"
	default "tl3562-minievm.img" if PLATFORM_RK3562
	help
	  Make target used to build the kernel image.

endmenu

menu "Build Configuration"

config OBC_SDK_ARCH
	string "Target Architecture"
	default "arm"
	help
	  Target architecture for cross-compilation.

config OBC_SDK_COMP
	string "Cross Compiler Prefix"
	default "arm-buildroot-linux-gnueabihf-" if PLATFORM_IMX6ULL
	default "arm-none-linux-gnueabihf-" if PLATFORM_RV1106
	default "aarch64-none-linux-gnu-" if PLATFORM_RK3562
	help
	  Cross compiler toolchain prefix.

config KERNEL_ARCH
	string "Kernel Architecture"
	default "arm64" if PLATFORM_RK3562
	help
	  Architecture passed to the kernel build. If empty, OBC_SDK_ARCH is used.

endmenu

menu "Bootloader Configuration"

source "bootloader/obcbase/Kconfig"

endmenu

menu "Tools Configuration"

source "tools/pack_tools/Kconfig"

endmenu

menu "Application File System (appfs)"

source "appfs/Kconfig"

endmenu

menu "Kernel Modules"

source "module/Kconfig"

endmenu
```

## obc-1.0.0/appfs/Kconfig
```kconfig
menu "appfs Config"

config APPFS_TOOLS_MEM
	bool "Enable tools-mem (Memory Statistics Tool)"
	default n
	help
	  Build the memory statistics tool for system memory monitoring.

config APPFS_TOOLS_SMART
	bool "Enable tools-smart"
	default n
	help
	  Build the tools-smart application.

config APPFS_TOOLS_PRIORITY
	bool "Enable tools-priority"
	default n
	help
	  Build the tools-priority application.

config APPFS_LITE_MONITOR
	bool "Enable LiteMonitor"
	default n
	help
	  Build the LiteMonitor application.

config APPFS_STOCK_MONITOR
	bool "Enable StockMonitor"
	default n
	help
	  Build the StockMonitor application.

config APPFS_LVGL
	bool "Enable LVGL"
	default n
	help
	  Build the LVGL graphics library applications.

config APPFS_CAMERA_FB
	bool "Enable camera-fb"
	default n
	help
	  Build the camera framebuffer application.

config APPFS_PXP_DEMO
	bool "Enable pxp_demo"
	default n
	help
	  Build the PXP demo application.

config APPFS_PRINTF_TEST
	bool "Enable printf_test"
	default n
	help
	  Build the printf test application.

config APPFS_UPGRADE
	bool "Enable upgrade"
	default n
	help
	  Build the upgrade application.

endmenu
```

## obc-1.0.0/bootloader/obcbase/Kconfig
```kconfig
config BOARD_CONFIG_IMX6ULL
    bool
    default y if PLATFORM_IMX6ULL

config BOARD_CONFIG_RV1106
    bool
    default y if PLATFORM_RV1106

config BOARD_CONFIG_RK3562
    bool
    default y if PLATFORM_RK3562
```

## obc-1.0.0/system/Kconfig
```kconfig
menu "Application File System (appfs)"

source "system/appfs/Kconfig"

menu "Auto Tools"

source "system/auto-tools/Kconfig"

endmenu

menu "Third-party Components"

source "system/third-part/Kconfig"

endmenu

endmenu
```

## obc-1.0.0/system/appfs/Kconfig
```kconfig
menu "appfs Config"

config APPFS_LITE_MONITOR
	bool "Enable LiteMonitor"
	default n
	help
	  Build the LiteMonitor application.

config APPFS_STOCK_MONITOR
	bool "Enable StockMonitor"
	default n
	help
	  Build the StockMonitor application.

config APPFS_LVGL
	bool "Enable LVGL"
	default n
	help
	  Build the LVGL graphics library applications.

config APPFS_CAMERA_FB
	bool "Enable camera-fb"
	default n
	help
	  Build the camera framebuffer application.

config APPFS_PXP_DEMO
	bool "Enable pxp_demo"
	default n
	help
	  Build the PXP demo application.

config APPFS_PRINTF_TEST
	bool "Enable printf_test"
	default n
	help
	  Build the printf test application.

config APPFS_UPGRADE
	bool "Enable upgrade"
	default n
	help
	  Build the upgrade application.

endmenu
```

## obc-1.0.0/system/auto-tools/Kconfig
```kconfig
config AUTO_TOOLS_MEM
	bool "Enable auto-mem (Memory Statistics Tool)"
	default n
	help
	  Build and stage the auto-mem system memory statistics tool.

config AUTO_TOOLS_SMART
	bool "Enable auto-smart"
	default n
	help
	  Build and stage the auto-smart memory vendor monitor.

config AUTO_TOOLS_PRIORITY
	bool "Enable auto-priority"
	default n
	help
	  Build and stage the auto-priority thread and CPU usage tool.
```

## obc-1.0.0/tools/am62x-pack-tools/tools/sign_tools/Kconfig
```kconfig
menu "Sign Tools"

config TOOLS_SIGN
	bool "Build EMS sign tools"
	default y
endmenu
```

## obc-1.0.0/tools/sign_tools/Kconfig
```kconfig
menu "Sign Tools"

config TOOLS_SIGN
	bool "Build OBC sign tools"
	default y
endmenu
```

## rootfs/busybox/busybox1.36.1_defconfig
```kconfig
# ARM64 BusyBox 1.36.1 configuration for the OBC initramfs.
CONFIG_DESKTOP=y
CONFIG_LFS=y
CONFIG_FEATURE_INSTALLER=y
CONFIG_INIT=y
CONFIG_FEATURE_USE_INITTAB=y
CONFIG_REBOOT=y
CONFIG_FEATURE_WAIT_FOR_INIT=y
CONFIG_ASH=y
CONFIG_ASH_OPTIMIZE_FOR_SIZE=y
CONFIG_ASH_EXPAND_PRMT=y
CONFIG_ASH_TEST=y
CONFIG_ASH_CMDCMD=y
CONFIG_SH_IS_ASH=y
CONFIG_FEATURE_EDITING=y
CONFIG_FEATURE_EDITING_HISTORY=64
CONFIG_FEATURE_TAB_COMPLETION=y
CONFIG_FEATURE_EDITING_FANCY_PROMPT=y
CONFIG_MOUNT=y
CONFIG_FEATURE_MOUNT_FLAGS=y
CONFIG_UMOUNT=y
CONFIG_MOUNTPOINT=y
CONFIG_IP=y
CONFIG_FEATURE_IP_ADDRESS=y
CONFIG_FEATURE_IP_LINK=y
CONFIG_FEATURE_IP_ROUTE=y
CONFIG_IFCONFIG=y
CONFIG_FEATURE_IFCONFIG_STATUS=y
CONFIG_FEATURE_IFCONFIG_HW=y
CONFIG_FEATURE_IFCONFIG_BROADCAST_PLUS=y
CONFIG_ROUTE=y
CONFIG_UDHCPC=y
CONFIG_PING=y
CONFIG_CAT=y
CONFIG_ECHO=y
CONFIG_GREP=y
CONFIG_KILL=y
CONFIG_KILLALL=y
CONFIG_LS=y
CONFIG_MKDIR=y
CONFIG_MKNOD=y
CONFIG_SLEEP=y
CONFIG_SYNC=y
CONFIG_TEST=y
CONFIG_TEST1=y
CONFIG_TOUCH=y
CONFIG_HOSTNAME=y
CONFIG_PS=y
CONFIG_DMESG=y
CONFIG_TAR=y
CONFIG_GZIP=y
CONFIG_GUNZIP=y
CONFIG_CPIO=y
CONFIG_FEATURE_PREFER_APPLETS=y

# Common file, text, and shell utilities.
CONFIG_BASENAME=y
CONFIG_CHGRP=y
CONFIG_CHMOD=y
CONFIG_CHOWN=y
CONFIG_CP=y
CONFIG_CUT=y
CONFIG_DATE=y
CONFIG_DD=y
CONFIG_DF=y
CONFIG_FEATURE_HUMAN_READABLE=y
CONFIG_DIRNAME=y
CONFIG_DU=y
CONFIG_ENV=y
CONFIG_EXPR=y
CONFIG_FALSE=y
CONFIG_HEAD=y
CONFIG_ID=y
CONFIG_LN=y
CONFIG_MKTEMP=y
CONFIG_MV=y
CONFIG_OD=y
CONFIG_PRINTENV=y
CONFIG_PRINTF=y
CONFIG_PWD=y
CONFIG_READLINK=y
CONFIG_REALPATH=y
CONFIG_RM=y
CONFIG_RMDIR=y
CONFIG_SEQ=y
CONFIG_SORT=y
CONFIG_STAT=y
CONFIG_STTY=y
CONFIG_TAIL=y
CONFIG_TEE=y
CONFIG_TR=y
CONFIG_TRUE=y
CONFIG_TTY=y
CONFIG_UNAME=y
CONFIG_UNIQ=y
CONFIG_WC=y
CONFIG_WHOAMI=y
CONFIG_YES=y
CONFIG_AWK=y
CONFIG_CMP=y
CONFIG_DIFF=y
CONFIG_SED=y
CONFIG_VI=y
CONFIG_LESS=y
CONFIG_WHICH=y
CONFIG_CLEAR=y
CONFIG_RESET=y

# File search and archive handling.
CONFIG_FIND=y
CONFIG_FEATURE_FIND_PRINT0=y
CONFIG_FEATURE_FIND_MTIME=y
CONFIG_FEATURE_FIND_PERM=y
CONFIG_FEATURE_FIND_TYPE=y
CONFIG_FEATURE_FIND_MAXDEPTH=y
CONFIG_FEATURE_FIND_NEWER=y
CONFIG_FEATURE_FIND_EXEC=y
CONFIG_FEATURE_FIND_USER=y
CONFIG_FEATURE_FIND_GROUP=y
CONFIG_FEATURE_FIND_SIZE=y
CONFIG_FEATURE_FIND_DELETE=y
CONFIG_FEATURE_FIND_EMPTY=y
CONFIG_FEATURE_FIND_PATH=y
CONFIG_XARGS=y
CONFIG_FEATURE_TAR_CREATE=y
CONFIG_FEATURE_TAR_FROM=y
CONFIG_FEATURE_TAR_GNU_EXTENSIONS=y
CONFIG_UNZIP=y

# Process and system inspection.
CONFIG_FREE=y
CONFIG_PGREP=y
CONFIG_PIDOF=y
CONFIG_TOP=y
CONFIG_UPTIME=y
CONFIG_WATCH=y
CONFIG_BLKID=y
CONFIG_MKE2FS=y
CONFIG_MKFS_EXT2=y
CONFIG_FEATURE_BLKID_TYPE=y
CONFIG_BLOCKDEV=y
# BusyBox 1.36.1 does not provide sfdisk; use fdisk for this minimal image.
CONFIG_FDISK=y
CONFIG_FEATURE_FDISK_WRITABLE=y
CONFIG_FEATURE_GPT_LABEL=y
CONFIG_HEXDUMP=y
CONFIG_HD=y
CONFIG_HWCLOCK=y
CONFIG_LOSETUP=y
CONFIG_LSPCI=y
CONFIG_LSUSB=y
CONFIG_MDEV=y
CONFIG_FEATURE_MDEV_CONF=y
CONFIG_FEATURE_MDEV_EXEC=y
CONFIG_INSMOD=y
CONFIG_LSMOD=y
CONFIG_RMMOD=y
CONFIG_DEVMEM=y
CONFIG_I2CGET=y
CONFIG_I2CSET=y
CONFIG_I2CDUMP=y
CONFIG_I2CDETECT=y
CONFIG_MICROCOM=y
CONFIG_PARTPROBE=y
CONFIG_STRINGS=y
CONFIG_TREE=y

# Common network diagnostics and configuration.
CONFIG_FEATURE_IPV6=y
CONFIG_FEATURE_IP_RULE=y
CONFIG_FEATURE_IP_NEIGH=y
CONFIG_PING6=y
CONFIG_ARP=y
CONFIG_ARPING=y
CONFIG_BRCTL=y
CONFIG_FEATURE_BRCTL_SHOW=y
CONFIG_NETSTAT=y
CONFIG_NSLOOKUP=y
CONFIG_TRACEROUTE=y
CONFIG_WGET=y
CONFIG_FEATURE_WGET_STATUSBAR=y
CONFIG_FEATURE_WGET_TIMEOUT=y
```
